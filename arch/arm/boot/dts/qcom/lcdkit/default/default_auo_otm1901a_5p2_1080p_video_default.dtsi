/* Copyright (c) 2013, The Linux Foundation. All rights reserved.
 *
 * This program is free software; you can redistribute it and/or modify
 * it under the terms of the GNU General Public License version 2 and
 * only version 2 as published by the Free Software Foundation.
 *
 * This program is distributed in the hope that it will be useful,
 * but WITHOUT ANY WARRANTY; without even the implied warranty of
 * MERCHANTABILITY or FITNESS FOR A PARTICULAR PURPOSE.  See the
 * GNU General Public License for more details.
 */

/*-------------------------------------------------------------------------
 * This file is autogenerated file using gcdb parser. Please do not edit it.
 * Update input XML file to add a new entry or update variable in this file
 * VERSION = 1.1
 *-----------------------------------------------------------------------*/
/ {
	dsi_default_auo_otm1901a_5p2_1080p_video_default: lcdkit_default_auo_otm1901a_5p2_1080p_video_default {
		compatible = "auo_otm1901a_5p2_1080p_video_default";
		hw,lcdkit-panel-name = "AUO_OTM1901A 5.2' VIDEO TFT 1080 x 1920 DEFAULT";
		hw,lcdkit-panel-type = <0x01>;
		hw,lcdkit-panel-xres = <1080>;
		hw,lcdkit-panel-yres = <1920>;
		hw,lcdkit-panel-width = <75>;
		hw,lcdkit-panel-height = <133>;
		hw,lcdkit-panel-on-command = [29 01 00 00 0a 00 02 00 00
				29 01 00 00 0a 00 04 FF 19 01 01
				29 01 00 00 0a 00 02 00 80
				29 01 00 00 0a 00 03 FF 19 01
				29 01 00 00 0a 00 02 00 88
				29 01 00 00 0a 00 02 f3 00
				29 01 00 00 0a 00 02 00 B0
				29 01 00 00 0a 00 02 CA 01
				29 01 00 00 0a 00 02 00 B1
				29 01 00 00 0a 00 02 CA 01
				29 01 00 00 0a 00 02 00 B3
				29 01 00 00 0a 00 02 CA 40
				29 01 00 00 0a 00 02 00 00
				29 01 00 00 0a 00 04 FF FF FF FF
				15 01 00 00 0a 00 02 35 01
				15 01 00 00 0a 00 02 53 24
				15 01 00 00 0a 00 02 55 00
				15 01 00 00 0a 00 02 5E 28
				05 01 00 00 78 01 02 11 00
				05 01 00 00 64 01 02 29 00];
		hw,lcdkit-panel-display-on-command = [05 01 00 00 78 01 02 29 00];
		hw,lcdkit-panel-off-command = [05 01 00 00 3C 01 02 28 00
			05 01 00 00 78 01 02 10 00];
		hw,lcdkit-panel-backlight-command = [15 01 00 00 00 00 02 51 00];
		hw,lcdkit-panel-cabc-support = <0>;
		hw,lcdkit-panel-display-on-effect-command = [15 01 00 00 0a 00 02 55 81];
		hw,lcdkit-panel-inversion-support = <1>;
		hw,lcdkit-panel-scan-support = <1>;
		hw,lcdkit-panel-display-region-support = <0>;
		hw,lcdkit-panel-checksum-support = <0>;
		hw,lcdkit-panel-esd-support = <0>;
		hw,lcdkit-panel-check-reg-support = <1>;
		hw,lcdkit-panel-mipi-detect-support = <0>;
		hw,lcdkit-panel-shutdown-sleep-support = <0>;
		hw,lcdkit-dsi-bpp = <24>;
		hw,lcdkit-panel-cmd-type = <0>;
		hw,lcdkit-pixel-packing = <0>;
		hw,lcdkit-underflow-color = <0x00>;
		hw,lcdkit-border-color = <0>;
		hw,lcdkit-panel-orientation = <0>;
		hw,lcdkit-brightness-max-level = <4095>;
		hw,lcdkit-bl-min-level = <40>;
		hw,lcdkit-bl-max-level = <4095>;
		hw,lcdkit-interleave-mode = <0>;
		hw,lcdkit-te-check-enable;
		hw,lcdkit-te-using-te-pin;
		hw,lcdkit-h-sync-pulse = <1>;
		hw,lcdkit-bllp-power-mode;
		hw,lcdkit-bllp-eof-power-mode;
		hw,lcdkit-traffic-mode = "burst_mode";
		hw,lcdkit-te-dcs-command = <1>;
		hw,lcdkit-te-pin-select = <1>;
		hw,lcdkit-virtual-channel-id = <0>;
		hw,lcdkit-color-order = "rgb_swap_rgb";
		hw,lcdkit-lane-0-state;
		hw,lcdkit-lane-1-state;
		hw,lcdkit-lane-2-state;
		hw,lcdkit-lane-3-state;
		hw,lcdkit-h-left-border = <0>;
		hw,lcdkit-h-right-border = <0>;
		hw,lcdkit-v-top-border = <0>;
		hw,lcdkit-v-bottom-border = <0>;
		hw,lcdkit-panel-framerate = <60>;
		hw,lcdkit-panel-clockrate = <445730000>;
		hw,lcdkit-panel-timings = [1E 1B 04 06 02 03 04 A0
			1E 1B 04 06 02 03 04 A0
			1E 1B 04 06 02 03 04 A0
			1E 1B 04 06 02 03 04 A0
			1E 0E 04 05 02 03 04 A0];
		hw,lcdkit-panel-timings-phy-v2 = [1E 1B 04 06 02 03 04 A0
			1E 1B 04 06 02 03 04 A0
			1E 1B 04 06 02 03 04 A0
			1E 1B 04 06 02 03 04 A0
			1E 0E 04 05 02 03 04 A0];
		hw,lcdkit-t-clk-pre = <0x26>;
		hw,lcdkit-t-clk-post = <0x04>;
		hw,lcdkit-tx-eot-append;
		hw,lcdkit-stream = <0>;
		hw,lcdkit-lp11-init;
		hw,lcdkit-mdp-trigger = "none";
		hw,lcdkit-dma-trigger = "trigger_sw";
		hw,lcdkit-bl-pmic-control-type = "bl_ctrl_wled";
		qcom,panel-supply-entries = <&dsi_panel_pwr_supply>;
		hw,lcdkit-lane-map = "lane_map_0123";
		hw,lcdkit-delay-before-bl = <0>;
		hw,lcdkit-mipi-regulator-mode = <1>;
		hw,lcdkit-delay-af-rst-off = <20>;
		hw,lcdkit-delay-af-blic-init = <0>;
		hw,lcdkit-bl-level-limit-percent = <100>;
		hw,lcdkit-use-second-ic-for-esd = <0>;
		hw,lcdkit-esd-check-num = <3>;
		hw,lcdkit-h-back-porch = <52>;
		hw,lcdkit-h-front-porch = <52>;
		hw,lcdkit-h-pulse-width = <20>;
		hw,lcdkit-v-back-porch = <16>;
		hw,lcdkit-v-pulse-width = <9>;
		hw,lcdkit-v-front-porch = <2>;
		hw,lcdkit-h-sync-skew = <0>;
		hw,lcdkit-lcd-type = <0>;
		hw,lcdkit-panel-pt-test-support = <1>;
		hw,lcdkit-bias-power-ctrl-mode = <0x01>;
		hw,lcdkit-iovcc-power-ctrl-mode = <0x01>;
		hw,lcdkit-vci-power-ctrl-mode = <0x01>;
		hw,lcdkit-id0-gpio = <59>;
		hw,lcdkit-id1-gpio = <66>;
		hw,lcdkit-reset-gpio = <61>;
		hw,lcdkit-te-gpio = <0>;
		hw,lcdkit-vsp-gpio = <0>;
		hw,lcdkit-vsn-gpio = <0>;
		hw,lcdkit-iovcc-gpio = <0>;
		hw,lcdkit-vci-gpio = <0>;
		hw,lcdkit-bl-gpio = <59>;
		hw,lcdkit-iovcc-on-is-need-reset = <0>;
		hw,lcdkit-vsn-on-is-need-reset = <0>;
		hw,lcdkit-lcd-vsp = <5500000>;
		hw,lcdkit-lcd-vsn = <5500000>;
		hw,lcdkit-lcd-rst-first-high = <10>;
		hw,lcdkit-lcd-rst-low = <10>;
		hw,lcdkit-lcd-rst-second-high = <50>;
		hw,lcdkit-delay-af-vci-on = <0>;
		hw,lcdkit-delay-af-iovcc-on = <10>;
		hw,lcdkit-delay-af-bias-on = <0>;
		hw,lcdkit-delay-af-vsp-on = <50>;
		hw,lcdkit-delay-af-vsn-on = <3>;
		hw,lcdkit-delay-af-lp11 = <0>;
		hw,lcdkit-delay-af-tp-reset = <25>;
		hw,lcdkit-delay-af-vsn-off = <3>;
		hw,lcdkit-delay-af-vsp-off = <0>;
		hw,lcdkit-delay-af-bias-off = <0>;
		hw,lcdkit-delay-af-iovcc-off = <0>;
		hw,lcdkit-delay-af-vci-off = <0>;
		hw,lcdkit-panel-off-reset-high = <0>;
    };
};